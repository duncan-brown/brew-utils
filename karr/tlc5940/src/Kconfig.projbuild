## karr/tlc5940/src/Kconfig.projbuild
```kconfig
menu "ST7789 Configuration"

	config WIDTH
		int "SCREEN WIDTH"
		range 0 999
		default 135
		help
			The width resolution of the screen.

	config HEIGHT
		int "SCREEN HEIGHT"
		range 0 999
		default 240
		help
			The height resolution of the screen.

	config OFFSETX
		int "GRAM X OFFSET"
		range 0 99
		default 52
		help
			When your TFT have offset(X), set it.

	config OFFSETY
		int "GRAM Y OFFSET"
		range 0 99
		default 40
		help
			When your TFT have offset(Y), set it.

	config MOSI_GPIO
		int "MOSI GPIO number"
		range 0 46
		default 19 if IDF_TARGET_ESP32
		default 35 if IDF_TARGET_ESP32S2
		default 0  if IDF_TARGET_ESP32C3
		help
			GPIO number (IOxx) to SPI MOSI.
			Some GPIOs are used for other purposes (flash connections, etc.) and cannot be used to MOSI.
			On the ESP32, GPIOs 35-39 are input-only so cannot be used as outputs.
			On the ESP32-S2, GPIO 46 is input-only so cannot be used as outputs.

	config SCLK_GPIO
		int "SCLK GPIO number"
		range 0 46
		default 18 if IDF_TARGET_ESP32
		default 36 if IDF_TARGET_ESP32S2
		default 1  if IDF_TARGET_ESP32C3
		help
			GPIO number (IOxx) to SPI SCLK.
			Some GPIOs are used for other purposes (flash connections, etc.) and cannot be used to SCLK.
			On the ESP32, GPIOs 35-39 are input-only so cannot be used as outputs.
			On the ESP32-S2, GPIO 46 is input-only so cannot be used as outputs.

	config CS_GPIO
		int "CS GPIO number"
		range -1 46
		default 5 if IDF_TARGET_ESP32
		default 34 if IDF_TARGET_ESP32S2
		default -1 if IDF_TARGET_ESP32C3
		help
			GPIO number (IOxx) to SPI CS.
			When it is -1, CS isn't performed.
			Some GPIOs are used for other purposes (flash connections, etc.) and cannot be used to CS.
			On the ESP32, GPIOs 35-39 are input-only so cannot be used as outputs.
			On the ESP32-S2, GPIO 46 is input-only so cannot be used as outputs.

	config DC_GPIO
		int "DC GPIO number"
		range 0 46
		default 16 if IDF_TARGET_ESP32
		default 37 if IDF_TARGET_ESP32S2
		default 2  if IDF_TARGET_ESP32C3
		help
			GPIO number (IOxx) to SPI DC.
			Some GPIOs are used for other purposes (flash connections, etc.) and cannot be used to DC.
			On the ESP32, GPIOs 35-39 are input-only so cannot be used as outputs.
			On the ESP32-S2, GPIO 46 is input-only so cannot be used as outputs.

	config RESET_GPIO
		int "RESET GPIO number"
		range 0 46
		default 23 if IDF_TARGET_ESP32
		default 38 if IDF_TARGET_ESP32S2
		default 3  if IDF_TARGET_ESP32C3
		help
			GPIO number (IOxx) to RESET.
			Some GPIOs are used for other purposes (flash connections, etc.) and cannot be used to RESET.
			On the ESP32, GPIOs 35-39 are input-only so cannot be used as outputs.
			On the ESP32-S2, GPIO 46 is input-only so cannot be used as outputs.

	config BL_GPIO
		int "BACKLIGHT GPIO number"
		range -1 46
		default 4 if IDF_TARGET_ESP32
		default 33 if IDF_TARGET_ESP32S2
		default 4  if IDF_TARGET_ESP32C3
		help
			GPIO number (IOxx) to BACKLIGHT.
			When it is -1, BACKLIGHT isn't performed.
			Some GPIOs are used for other purposes (flash connections, etc.) and cannot be used to BACKLIGHT.
			On the ESP32, GPIOs 35-39 are input-only so cannot be used as outputs.
			On the ESP32-S2, GPIO 46 is input-only so cannot be used as outputs.

	config INVERSION
		bool "Enable Display Inversion"
		default false
		help
			Enable Display Inversion.

endmenu

menu "TLC5940 Configuration"

	config VPRG_PIN
		int "VPRG GPIO Pin"
		range 0 46
		default 27
		help
			GPIO number (IOxx) for TLC5940 VPRG pin.

	config SIN_PIN
		int "SIN GPIO Pin"
		range 0 46
		default 33
		help
			GPIO number (IOxx) for SPI MOSI driving TLC5940 SIN pin.

	config SOUT_PIN
		int "SOUT GPIO Pin"
		range 0 46
		default 38
		help
			GPIO number (IOxx) for SPI MISO connected to TLC5940 SOUT pin.

	config SCLK_PIN
		int "SCLK GPIO Pin"
		range 0 46
		default 26
		help
			GPIO number (IOxx) for SPI CLK connected to TLC5940 SCLK pin.

	config XLAT_PIN
		int "XLAT GPIO Pin"
		range 0 46
		default 25
		help
			GPIO number (IOxx) for TLC5940 XLAT pin.

	config BLANK_PIN
		int "BLANK GPIO Pin"
		range 0 46
		default 32
		help
			GPIO number (IOxx) for TLC5940 BLANK pin.

	config DCPRG_PIN
		int "DCPRG GPIO Pin"
		range 0 46
		default 37
		help
			GPIO number (IOxx) for TLC5940 DCPRG pin.

	config GSCLK_PIN
		int "GSCLK GPIO Pin"
		range 0 46
		default 12
		help
			GPIO number (IOxx) for TLC5940 GSCLK pin.

	config COUNTER_PIN
		int "COUNTER GPIO Pin"
		range 0 46
		default 13
		help
			GPIO number (IOxx) for gray scale clock feedback.
			Should be connected to GSCLK pin.

	config LINES_NUMBER
		int "Number of MOSFET lines"
		range 0 3
		default 3
		help
			Number of GPIO pins to use for MOSFET line contol.

	config LINE_1_PIN
		int "MOSFET Line 1 Pin"
		range 0 46
		default 17
		help
			GPIO number (IOxx) for MOSFET 1.

	config LINE_2_PIN
		int "MOSFET Line 2 Pin"
		range 0 46
		default 2
		help
			GPIO number (IOxx) for MOSFET 2.

	config LINE_3_PIN
		int "MOSFET Line 3 Pin"
		range 0 46
		default 15
		help
			GPIO number (IOxx) for MOSFET 3.

endmenu
```
